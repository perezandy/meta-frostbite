## conf/layer.conf
```bitbake
BBPATH .= ":${LAYERDIR}"
BBFILES += "${LAYERDIR}/recipes-*/*/*.bb \
            ${LAYERDIR}/recipes-*/*/*.bbappend"
BBFILE_COLLECTIONS += "meta-frostbite"
BBFILE_PATTERN_meta-frostbite = "^${LAYERDIR}/"
BBFILE_PRIORITY_meta-frostbite = "6"
LAYERVERSION_meta-frostbite = "1"
LAYERSERIES_COMPAT_meta-frostbite = "whinlatter"
```
